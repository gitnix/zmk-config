## boards/shields/b1_pro/Kconfig.defconfig
```kconfig
# Copyright (c) 2024 The ZMK Contributors
# SPDX-License-Identifier: MIT

if SHIELD_B1_PRO

config ZMK_KEYBOARD_NAME
    default "B1 Pro"

endif
```

## boards/shields/b1_pro/Kconfig.shield
```kconfig
# Copyright (c) 2024 The ZMK Contributors
# SPDX-License-Identifier: MIT

config SHIELD_B1_PRO
    def_bool $(shields_list_contains,b1_pro)
```

## config/west.yml
```yaml
manifest:
  remotes:
    - name: keychron
      url-base: https://github.com/keychron
  projects:
    - name: zmk
      remote: keychron
      revision: keychron_bpro
      import: app/west.yml
  self:
    path: config
```
